## config/boards/shields/charybdis/Kconfig.defconfig
```kconfig
if SHIELD_CHARYBDIS_RIGHT

config ZMK_KEYBOARD_NAME
	default "Charybdis"

# 동글 사용을 위해 central 역할 제거
# config ZMK_SPLIT_BLE_ROLE_CENTRAL
#	default y

endif

if SHIELD_CHARYBDIS_LEFT || SHIELD_CHARYBDIS_RIGHT

config ZMK_SPLIT
	default y
	
endif
```
